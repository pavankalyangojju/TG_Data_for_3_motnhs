#include "BluetoothSerial.h" 
BluetoothSerial ESP_BT; //Object for Bluetooth
#include <ESP32Servo.h>
#include <SPI.h>
#include <Wire.h>
#include <Adafruit_GFX.h>
#include <Adafruit_SSD1306.h>

#define in1 15  
#define in2 16  
#define in3 17  
#define in4 19 

#define led1 4 
#define led2 13

#define SCREEN_WIDTH 128 // OLED display width, in pixels
#define SCREEN_HEIGHT 64 // OLED display height, in pixels

#define OLED_RESET 25
Adafruit_SSD1306 display(SCREEN_WIDTH, SCREEN_HEIGHT, &Wire, OLED_RESET);

#define LOGO_HEIGHT   64
#define LOGO_WIDTH    128

Servo motor_1;
Servo motor_2;
Servo motor_3;

int servo1 = 90;
int servo2 = 20;
int servo3 = 160;

const int motorSpeed = 200;

const int trigPin = 5;
const int echoPin = 18;
int distance;
long duration;

int bt_data;
 const unsigned char epd_bitmap_shock [] PROGMEM = {
  0xff, 0xff, 0xff, 0xff, 0xff, 0xff, 0xff, 0xf0, 0x00, 0x00, 0x7f, 0xff, 0xff, 0xff, 0xff, 0xff, 
  0xff, 0xff, 0xff, 0xff, 0xff, 0xff, 0xfc, 0x00, 0x00, 0x00, 0x03, 0xff, 0xff, 0xff, 0xff, 0xff, 
  0xff, 0xff, 0xff, 0xff, 0xff, 0xff, 0xc0, 0x00, 0x00, 0x00, 0x00, 0x1f, 0xff, 0xff, 0xff, 0xff, 
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  0xff, 0xff, 0xff, 0xff, 0xff, 0xff, 0xff, 0xff, 0xff, 0xff, 0xff, 0xff, 0xff, 0xff, 0xff, 0xcff
};

// Array of all bitmaps for convenience. (Total bytes used to store images in PROGMEM = 1040)
const int epd_bitmap_allArray_LEN = 1;
const unsigned char* epd_bitmap_allArray[1] = {
  epd_bitmap_shock
};

const unsigned char epd_bitmap_laugh_1__1_ [] PROGMEM = {
  0xff, 0xff, 0xff, 0xff, 0xff, 0xff, 0xff, 0xff, 0xff, 0xff, 0xff, 0xff, 0xff, 0xff, 0xff, 0xff, 
  0xff, 0xff, 0xff, 0xff, 0xff, 0xff, 0xff, 0xff, 0xff, 0xff, 0xff, 0xff, 0xff, 0xff, 0xff, 0xff, 
  0xff, 0xff, 0xff, 0xff, 0xff, 0xff, 0xff, 0xff, 0xff, 0xff, 0xff, 0xff, 0xff, 0xff, 0xff, 0xff, 
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  0xff, 0xff, 0xff, 0xff, 0xff, 0xff, 0xff, 0xff, 0xff, 0xff, 0xff, 0xff, 0xff, 0xff, 0xff, 0xff
};



 //three face
 const unsigned char epd_bitmap_28_282956_toothy_plain_mouth_mouth_png__2_ [] PROGMEM = {
 0xff, 0xff, 0xff, 0xff, 0xff, 0xff, 0xff, 0xff, 0xff, 0xff, 0xff, 0xff, 0xff, 0xff, 0xff, 0xff, 
  0xff, 0xff, 0xff, 0xff, 0xff, 0xff, 0xff, 0xff, 0xff, 0xff, 0xff, 0xff, 0xff, 0xff, 0xff, 0xff, 
  0xff, 0xff, 0xff, 0xff, 0xff, 0xff, 0xff, 0xff, 0xff, 0xff, 0xff, 0xff, 0xff, 0xff, 0xff, 0xff, 
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  0xff, 0xff, 0xff, 0xff, 0xff, 0xff, 0xff, 0xff, 0xff, 0xff, 0xff, 0xff, 0xff, 0xff, 0xff, 0xff
};
 
 // four

 const unsigned char epd_bitmap_image__1___2_ [] PROGMEM = {
 0xff, 0xff, 0xff, 0xff, 0xff, 0xff, 0xff, 0xff, 0xff, 0xff, 0xff, 0xff, 0xff, 0xff, 0xff, 0xff, 
  0xff, 0xff, 0xff, 0xff, 0xff, 0xff, 0xff, 0xff, 0xff, 0xff, 0xff, 0xff, 0xff, 0xff, 0xff, 0xff, 
  0xff, 0xff, 0xff, 0xff, 0xff, 0xff, 0xff, 0xff, 0xff, 0xff, 0xff, 0xff, 0xff, 0xff, 0xff, 0xff, 
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  0xff, 0xff, 0xff, 0xff, 0xff, 0xff, 0xff, 0xff, 0xff, 0xff, 0xff, 0xff, 0xff, 0xff, 0xff, 0xff
};

void setup() {
  Serial.begin(9600); //Start Serial monitor in 9600
  ESP_BT.begin("humanoid bt");
 
  Serial.println("Bluetooth Device is Ready to Pair");

  // SSD1306_SWITCHCAPVCC = generate display voltage from 3.3V internally
  if(!display.begin(SSD1306_SWITCHCAPVCC, 0x3C)) { // Address 0x3D for 128x64
    Serial.println(F("SSD1306 allocation failed"));
    for(;;); // Don't proceed, loop forever
  }

  testdrawbitmap();    // Draw the required image 

 
pinMode(in1, OUTPUT);  
pinMode(in2, OUTPUT);  
pinMode(in3, OUTPUT);  
pinMode(in4, OUTPUT); 

  pinMode(trigPin, OUTPUT); 
  pinMode(echoPin, INPUT);

  pinMode(led1, OUTPUT);  
pinMode(led2, OUTPUT);
                         
motor_1.attach(32);
motor_2.attach(33);
motor_3.attach(27); 

motor_1.write(servo1); 
motor_2.write(servo2); 
motor_3.write(servo3);

     
}

void loop() {
  
  if (ESP_BT.available()) //Check if we receive anything from Bluetooth
  {
    bt_data = ESP_BT.read(); //Read what we recevive 
    Serial.print("Received:"); Serial.println(bt_data);
  }
if(bt_data == 1){forword(); }   
else if(bt_data == 2){backword();}   
else if(bt_data == 3){turnLeft();}  
else if(bt_data == 4){turnRight();}  
else if(bt_data == 5){Stop(); }      
else  if (bt_data == 22){dance(); }
else if (bt_data ==33 ){Stop(); }

else if (bt_data ==61 ){ledon(); }
else if (bt_data ==62 ){ledoff(); }
     
else if (bt_data == 10){
if(servo1>0){servo1 = servo1-1;}
motor_1.write(servo1);
}
else if (bt_data == 50){
if(servo1=90){servo1 = servo1-1;}
motor_1.write(servo1);
}
else if (bt_data == 11){
if(servo1<180){servo1 = servo1+1;}
motor_1.write(servo1);  
}

else if(bt_data == 12){
if(servo2>0){servo2 = servo2-1;}
motor_2.write(servo2);
}
else if (bt_data == 13){
if(servo2<180){servo2 = servo2+1;}
motor_2.write(servo2);
}

else if (bt_data == 15){
if(servo3<180){servo3 = servo3+1;}
motor_3.write(servo3);
}
else if(bt_data == 14){
if(servo3>0){servo3 = servo3-1;}
motor_3.write(servo3);
}


digitalWrite(trigPin, LOW);
delayMicroseconds(2);

// Sets the trigPin on HIGH state for 10 micro seconds
digitalWrite(trigPin, HIGH);
delayMicroseconds(10);
digitalWrite(trigPin, LOW);

// Reads the echoPin, returns the sound wave travel time in microseconds
duration = pulseIn(echoPin, HIGH);

// Calculating the distance
distance= duration*0.034/2;



  if (bt_data == 40){
display.clearDisplay();

    display.drawBitmap(
    (display.width()  - LOGO_WIDTH ) / 2,
    (display.height() - LOGO_HEIGHT) / 2,
    epd_bitmap_shock, LOGO_WIDTH, LOGO_HEIGHT, 1);
    
  display.display();
  delay(1000);
  
  //second
  display.clearDisplay();
 
  display.drawBitmap(
    (display.width()  - LOGO_WIDTH ) / 2,
    (display.height() - LOGO_HEIGHT) / 2,
   epd_bitmap_laugh_1__1_, LOGO_WIDTH, LOGO_HEIGHT, 1);
    
  display.display();
  delay(1000);

  //three
    display.clearDisplay();
 
  display.drawBitmap(
    (display.width()  - LOGO_WIDTH ) / 2,
    (display.height() - LOGO_HEIGHT) / 2,
   epd_bitmap_28_282956_toothy_plain_mouth_mouth_png__2_, LOGO_WIDTH, LOGO_HEIGHT, 1);
    
  display.display();
  delay(1000);

  //four 
    display.clearDisplay();
 
  display.drawBitmap(
    (display.width()  - LOGO_WIDTH ) / 2,
    (display.height() - LOGO_HEIGHT) / 2,
  epd_bitmap_image__1___2_, LOGO_WIDTH, LOGO_HEIGHT, 1);
    
  display.display();
  delay(1000);
  
}
  if (bt_data == 41){
   
    display.clearDisplay();
  display.setTextSize(2);
  display.setTextColor(WHITE);
  display.setCursor(0,0);
  display.println("   ROBOT  ");
  display.setCursor(1,20);
  display.println(" SLEEPING");
   display.setCursor(2,40);
  display.println("   TIME");
  display.display();
  delay(1000);
  
  display.clearDisplay();
  display.setTextSize(2);
  display.setTextColor(WHITE);
   display.setCursor(0,0);
  display.println("   DON'T  ");
  display.setCursor(1,20);
  display.println("  DISTURB");
   display.setCursor(2,40);
  display.println("     ME");
  display.display();
  delay(1000);
  display.clearDisplay();
  }

  if (bt_data == 23) {
if(distance >10){
   
      analogWrite(in1, motorSpeed); // Right Motor forward Pin
      analogWrite(in2, 0);          // Right Motor backward Pin
      analogWrite(in3, motorSpeed); // Left Motor backward Pin
      analogWrite(in4, 0);          // Left Motor forward Pin
  }
  if(distance <10){
 
     analogWrite(in1, 0);          // Right Motor forward Pin
      analogWrite(in2, 0);          // Right Motor backward Pin
      analogWrite(in3, 0);          // Left Motor backward Pin
      analogWrite(in4, 0);          // Left Motor forward Pin
      delay(1000);
      analogWrite(in1, 0);          // Right Motor forward Pin
      analogWrite(in2, motorSpeed); // Right Motor backward Pin
      analogWrite(in3, 0);          // Left Motor backward Pin
      analogWrite(in4, motorSpeed); // Left Motor forward Pin
      delay(2000);
      analogWrite(in1, motorSpeed); // Right Motor forward Pin
      analogWrite(in2, 0);          // Right Motor backward Pin
      analogWrite(in3, 0);          // Left Motor backward Pin
      analogWrite(in4, motorSpeed); // Left Motor forward Pin 
    


  }}
    if (bt_data == 24){Stop(); } 

  delay(20);
}

void ledon(){  //ledon
digitalWrite(4, HIGH);
digitalWrite(13, HIGH); 
}

void ledoff(){  //ledoff
digitalWrite(4, LOW);
digitalWrite(13, LOW);
 
}


void forword() {
  analogWrite(in1, motorSpeed); // Right Motor forward Pin
  analogWrite(in2, 0);          // Right Motor backward Pin
  analogWrite(in3, motorSpeed); // Left Motor backward Pin
  analogWrite(in4, 0);          // Left Motor forward Pin
}

void backword() {
  analogWrite(in1, 0);          // Right Motor forward Pin
  analogWrite(in2, motorSpeed); // Right Motor backward Pin
  analogWrite(in3, 0);          // Left Motor backward Pin
  analogWrite(in4, motorSpeed); // Left Motor forward Pin
}

void turnRight() {
  analogWrite(in1, 0);          // Right Motor forward Pin
  analogWrite(in2, motorSpeed); // Right Motor backward Pin
  analogWrite(in3, motorSpeed); // Left Motor backward Pin
  analogWrite(in4, 0);          // Left Motor forward Pin
}

void turnLeft() {
  analogWrite(in1, motorSpeed); // Right Motor forward Pin
  analogWrite(in2, 0);          // Right Motor backward Pin
  analogWrite(in3, 0);          // Left Motor backward Pin
  analogWrite(in4, motorSpeed); // Left Motor forward Pin
}

void Stop() {
  analogWrite(in1, 0); // Right Motor forward Pin
  analogWrite(in2, 0); // Right Motor backward Pin
  analogWrite(in3, 0); // Left Motor backward Pin
  analogWrite(in4, 0); // Left Motor forward Pin
}

void dance() {
  analogWrite(in1, motorSpeed); // Right Motor forward Pin
  analogWrite(in2, 0);          // Right Motor backward Pin
  analogWrite(in3, motorSpeed); // Left Motor backward Pin
  analogWrite(in4, 0);          // Left Motor forward Pin
  delay(2000);

  analogWrite(in1, 0);          // Right Motor forward Pin
  analogWrite(in2, motorSpeed); // Right Motor backward Pin
  analogWrite(in3, motorSpeed); // Left Motor backward Pin
  analogWrite(in4, 0);          // Left Motor forward Pin
  delay(2000);

  analogWrite(in1, motorSpeed); // Right Motor forward Pin
  analogWrite(in2, 0);          // Right Motor backward Pin
  analogWrite(in3, 0);          // Left Motor backward Pin
  analogWrite(in4, motorSpeed); // Left Motor forward Pin
  delay(2000);

  analogWrite(in1, 0);          // Right Motor forward Pin
  analogWrite(in2, motorSpeed); // Right Motor backward Pin
  analogWrite(in3, motorSpeed); // Left Motor backward Pin
  analogWrite(in4, 0);          // Left Motor forward Pin
  delay(2000);

  analogWrite(in1, motorSpeed); // Right Motor forward Pin
  analogWrite(in2, 0);          // Right Motor backward Pin
  analogWrite(in3, motorSpeed); // Left Motor backward Pin
  analogWrite(in4, 0);          // Left Motor forward Pin
}
 void testdrawbitmap(void) {
  
display.clearDisplay();
  display.setTextSize(2);
  display.setTextColor(WHITE);
  display.setCursor(0,0);
  display.println(" FOR ROBOT ");
  display.setCursor(1,20);
  display.println("  WAKEUP");
  display.setCursor(2,40);
  display.println(" PRESS D.P");
  display.display();
  delay(1000);
   
} 
